## boards/shields/prospector_scanner_mono_128x64/Kconfig.shield
```kconfig
# Copyright (c) 2024 The ZMK Contributors
# SPDX-License-Identifier: MIT

config SHIELD_PROSPECTOR_SCANNER_MONO_128X64
    def_bool $(shields_list_contains,prospector_scanner_mono_128x64)
```

## boards/shields/prospector_scanner_oled/Kconfig.defconfig
```kconfig
# Copyright (c) 2024 The ZMK Contributors
# SPDX-License-Identifier: MIT

if SHIELD_PROSPECTOR_SCANNER_OLED

config ZMK_KEYBOARD_NAME
    default "Prospector"

config ZMK_DISPLAY
    default y

# I2C bus for the OLED
config I2C
    default y

# Monochrome LVGL: 1 bit per pixel
config LV_Z_BITS_PER_PIXEL
    default 1

choice LV_COLOR_DEPTH
    default LV_COLOR_DEPTH_1
endchoice

# Custom status screen (mono scanner UI)
choice ZMK_DISPLAY_STATUS_SCREEN
    default ZMK_DISPLAY_STATUS_SCREEN_CUSTOM
endchoice

# --- dongle_display widget options (from englmaxi/zmk-dongle-display) ---
# Defined here so the ported presentation code compiles unchanged. Enable the
# widgets used by the default layout; bongo_cat / wpm are added later.
config ZMK_DONGLE_DISPLAY_LAYER
    bool
    default y

config ZMK_DONGLE_DISPLAY_LAYER_NAME_SCROLL_WIDTH
    int
    default 50

config ZMK_DONGLE_DISPLAY_LAYER_TEXT_ALIGN
    string
    default "left"

config ZMK_DONGLE_DISPLAY_MODIFIERS
    bool
    default y

config ZMK_DONGLE_DISPLAY_MAC_MODIFIERS
    bool
    default y

config ZMK_DONGLE_DISPLAY_BONGO_CAT
    bool
    default y

config ZMK_DONGLE_DISPLAY_WPM
    bool
    default y

config ZMK_DONGLE_DISPLAY_WPM_DISABLED_LAYERS
    string
    default ""

# --- Battery widget selection ---
choice PROSPECTOR_OLED_BATTERY_WIDGET
    prompt "Battery widget style"
    default PROSPECTOR_OLED_BATTERY_GAUGE
    help
      Which battery widget to show in the top-right corner.

config PROSPECTOR_OLED_BATTERY_GAUGE
    bool "Vertical gauges (left half / dongle / right half)"
    help
      Three vertical battery gauges filled bottom-to-top by percentage, no
      text; center is the Prospector dongle, outer two are the keyboard halves.

config PROSPECTOR_OLED_BATTERY_LEGACY
    bool "dongle_display battery (percentage text + small icon)"
    help
      The original englmaxi/zmk-dongle-display battery widget: stacked rows of
      percentage text plus a small battery icon.
endchoice

# --- Battery gauge widget (three vertical gauges: left / dongle / right) ---
config PROSPECTOR_OLED_CENTRAL_SIDE
    string "Physical side of the keyboard's central half (LEFT or RIGHT)"
    default "LEFT"
    help
      Which physical side the keyboard's central half is on. Determines which
      outer battery gauge shows the central vs peripheral half, since the
      scanner cannot infer it. Follows the CONFIG_ZMK_STATUS_ADV_CENTRAL_SIDE
      convention. LEFT (default) or RIGHT.

config PROSPECTOR_OLED_BATTERY_LOW_THRESHOLD
    int "Battery level below which a gauge blinks (percent)"
    range 0 100
    default 5
    help
      A battery gauge whose level is greater than 0 and below this threshold
      blinks. Set to 0 to disable blinking.

config PROSPECTOR_OLED_BATTERY_BLINK_MS
    int "Battery low-blink half-period in milliseconds"
    range 100 5000
    default 500
    help
      On/off interval for the low-battery blink (500ms = pulse on and off
      each half second).

endif
```

## boards/shields/prospector_scanner_oled/Kconfig.shield
```kconfig
# Copyright (c) 2024 The ZMK Contributors
# SPDX-License-Identifier: MIT

config SHIELD_PROSPECTOR_SCANNER_OLED
    def_bool $(shields_list_contains,prospector_scanner_oled)
```

## dts/bindings/behaviors/zmk,behavior-prospector-brightness.yaml
```yaml
# Copyright (c) 2024 The ZMK Contributors
# SPDX-License-Identifier: MIT

description: |
  Adjust the Prospector scanner display brightness. The one parameter selects
  direction: non-zero = brighter, 0 = dimmer. The level (0=off .. 7=max) is held
  on the central and broadcast to the scanner.

compatible: "zmk,behavior-prospector-brightness"

include: one_param.yaml
```
